## boards/shields/chaski/Kconfig.shield
```kconfig
config SHIELD_CHASKI_UNIBODY
    def_bool $(shields_list_contains,chaski_unibody)

config SHIELD_CHASKI_DONGLE
    def_bool $(shields_list_contains,chaski_dongle)

config SHIELD_CHASKI_PERIPHERAL
    def_bool $(shields_list_contains,chaski_peripheral)
```

## boards/shields/gigas/Kconfig.shield
```kconfig
config SHIELD_GIGAS_UNIBODY
    def_bool $(shields_list_contains,gigas_unibody)

config SHIELD_GIGAS_DONGLE
    def_bool $(shields_list_contains,gigas_dongle)

config SHIELD_GIGAS_PERIPHERAL
    def_bool $(shields_list_contains,gigas_peripheral)
```

## config/west.yml
```yaml
manifest:
  remotes:
    - name: zmkfirmware
      url-base: https://github.com/zmkfirmware
    - name: caksoylar
      url-base: https://github.com/caksoylar
    - name: carrefinho
      url-base: https://github.com/carrefinho
    - name: tadakado
      url-base: https://github.com/tadakado
  projects:
    - name: zmk
      remote: zmkfirmware
      # The revision needs to match in .github/workflows/build.ymn
      revision: v0.3
      import: app/west.yml
    - name: zmk-rgbled-widget
      remote: caksoylar
      revision: v0.3
    - name: prospector-zmk-module
      remote: carrefinho
      revision: main
    - name: zmk-ble-mouse-host
      remote: tadakado
      revision: main
  self:
    path: config
```
